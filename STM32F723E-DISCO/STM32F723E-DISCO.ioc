# file: STM32F723E-DISCO.ioc
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ADC1.Channel-0\#ChannelRegularConversion=ADC_CHANNEL_4
ADC1.NbrOfConversionFlag=1
ADC1.Rank-0\#ChannelRegularConversion=1
ADC1.SamplingTime-0\#ChannelRegularConversion=ADC_SAMPLETIME_3CYCLES
ADC1.master=1
ADC2.Channel-25\#ChannelRegularConversion=ADC_CHANNEL_4
ADC2.NbrOfConversionFlag=1
ADC2.Rank-25\#ChannelRegularConversion=1
ADC2.SamplingTime-25\#ChannelRegularConversion=ADC_SAMPLETIME_3CYCLES
ADC3.Channel-0\#ChannelRegularConversion=ADC_CHANNEL_8
ADC3.NbrOfConversionFlag=1
ADC3.Rank-0\#ChannelRegularConversion=1
ADC3.SamplingTime-0\#ChannelRegularConversion=ADC_SAMPLETIME_3CYCLES
CORTEX_M7.CPU_ICache=Disabled
CORTEX_M7.PREFETCH_ENABLE=0
FMC.WriteOperation1=FMC_WRITE_OPERATION_ENABLE
I2C1.I2C_Speed_Mode=I2C_Fast
I2C1.Timing=0x6000030D
I2C2.I2C_Speed_Mode=I2C_Fast
I2C2.Timing=0x6000030D
I2C3.I2C_Speed_Mode=I2C_Fast
I2C3.Speed=400
I2C3.Timing=0x6000030D
Mcu.Family=STM32F7
Mcu.Name=STM32F723I(C-E)Kx
Mcu.Package=UFBGA176
NVIC.OTG_FS_IRQn=true\:0\:0\:false\:false\:true\:true\:true\:true
NVIC.OTG_HS_IRQn=true\:0\:0\:false\:false\:true\:true\:true\:true
NVIC.PriorityGroup=NVIC_PRIORITYGROUP_4
NVIC.TIM1_UP_TIM10_IRQn=true\:15\:0\:false\:false\:true\:true\:true\:true
NVIC.TIM2_IRQn=true\:0\:0\:false\:false\:true\:true\:true\:true
NVIC.TimeBase=TIM1_UP_TIM10_IRQn
NVIC.TimeBaseIP=TIM1
NVIC.USART2_IRQn=true\:0\:0\:false\:false\:true\:true\:true\:true
PA0-WKUP.Signal=GPIO_Input
PA1.GPIO_Label=ARD_D10_TIM2_CH2_SPI1_NSS
PA1.Signal=S_TIM2_CH2
PA10.GPIO_Label=USB_OTG_FS_ID
PA10.Signal=GPIO_Output
PA11.Mode=Host_Only
PA11.Signal=USB_OTG_FS_DM
PA12.Mode=Host_Only
PA12.Signal=USB_OTG_FS_DP
PA13.Mode=Serial_Wire
PA13.Signal=SYS_JTMS-SWDIO
PA14.Mode=Serial_Wire
PA14.Signal=SYS_JTCK-SWCLK
PA2.Mode=Asynchronous
PA2.Signal=USART2_TX
PA3.GPIO_Label=ARD_D0_USART2_RX
PA3.Mode=Asynchronous
PA3.Signal=USART2_RX
PA4.GPIO_Label=ARD_A1
PA4.Signal=ADCx_IN4
PA5.GPIO_Label=ARD_D13_SPI1_SCK
PA5.Mode=Full_Duplex_Master
PA5.Signal=SPI1_SCK
PA6.GPIO_Label=ARD_A0
PA6.Signal=ADCx_IN6
PA7.Signal=GPIO_Output
PA8.GPIO_Label=CTP_SCL
PA8.GPIO_Pu=GPIO_PULLUP
PA8.Mode=I2C
PA8.Signal=I2C3_SCL
PA9.Mode=Activate_VBUS
PA9.Signal=USB_OTG_FS_VBUS
PB0.GPIO_Label=ARD_D5_STMOD_TIM3_CH3
PB0.Signal=S_TIM3_CH3
PB1.GPIO_Label=SYS_LD_USER2
PB1.Signal=GPIO_Output
PB10.GPIO_Label=USB_OTGFS_OVCR_INT
PB10.Signal=GPXTI10
PB11.GPIO_Label=PMOD_INT
PB11.Signal=GPXTI11
PB12.GPIO_Label=USB_OTG_HS_ID
PB12.Signal=GPIO_Output
PB13.GPIO_Label=USB_OTG_HS_VBUS
PB13.Signal=GPXTI13
PB14.Mode=Internal_Phy_Host
PB14.Signal=USB_OTG_HS_DM
PB15.Mode=Internal_Phy_Host
PB15.Signal=USB_OTG_HS_DP
PB2.GPIO_Label=QSPI_CLK [MX25L51245G_SCLK]
PB2.Mode=Single Bank 1
PB2.Signal=QUADSPI_CLK
PB3.GPIO_Label=SYS_STLINK_JTDO_SWO
PB3.Signal=SYS_JTDO-SWO
PB4.GPIO_Label=ARD_D12_SPI1_MISO
PB4.Mode=Full_Duplex_Master
PB4.Signal=SPI1_MISO
PB5.GPIO_Label=ARD_D11_TIM3_CH2_SPI1_MOSI
PB5.Mode=Full_Duplex_Master
PB5.Signal=SPI1_MOSI
PB6.GPIO_Label=QSPI_NCS [MX25L51245G_CS]
PB6.Mode=Single Bank 1
PB6.Signal=QUADSPI_BK1_NCS
PB7.GPIO_Label=NC1
PB7.Signal=FMC_NL
PB8.GPIO_Label=SAI2_I2C1_SCL [WM8994ECS/R_SCLK]
PB8.GPIO_Pu=GPIO_PULLUP
PB8.Mode=I2C
PB8.Signal=I2C1_SCL
PB9.GPIO_Label=SAI2_I2C1_SDA [WM8994ECS_SDA]
PB9.GPIO_Pu=GPIO_PULLUP
PB9.Mode=I2C
PB9.Signal=I2C1_SDA
PC0.GPIO_Label=ARD_A4
PC0.Signal=ADCx_IN10
PC1.GPIO_Label=ARD_A5
PC1.Signal=ADCx_IN11
PC10.GPIO_Label=QSPI_D1 [MX25L51245G_SIO1]
PC10.Mode=Single Bank 1
PC10.Signal=QUADSPI_BK1_IO1
PC11.GPIO_Label=STMOD_UART4_RXD_s
PC11.Signal=GPIO_Output
PC12.GPIO_Label=UART_TXD_WIFI_RX
PC12.Mode=Asynchronous
PC12.Signal=UART5_TX
PC14-OSC32_IN.Mode=LSE-External-Oscillator
PC14-OSC32_IN.Signal=RCC_OSC32_IN
PC15-OSC32_OUT.Mode=LSE-External-Oscillator
PC15-OSC32_OUT.Signal=RCC_OSC32_OUT
PC2.GPIO_Label=STMOD_SPI2_MISOs
PC2.Mode=Full_Duplex_Master
PC2.Signal=SPI2_MISO
PC3.GPIO_Label=STMOD+_SPI2_MOSIs
PC3.Mode=Full_Duplex_Master
PC3.Signal=SPI2_MOSI
PC4.GPIO_Label=ARD_A2
PC4.Signal=ADCx_IN14
PC5.GPIO_Label=ARD_D2_GPIO
PC5.Signal=GPIO_Output
PC6.GPIO_Label=VCP_TX [STM32F103CBT6_PA3]
PC6.Mode=Asynchronous
PC6.Signal=USART6_TX
PC7.GPIO_Label=VCP_RX [STM32F103CBT6_PA2]
PC7.Mode=Asynchronous
PC7.Signal=USART6_RX
PC8.GPIO_Label=LCD_TE_INT
PC8.Signal=GPXTI8
PC9.GPIO_Label=QSPI_D0 [MX25L51245G_SIO0]
PC9.Mode=Single Bank 1
PC9.Signal=QUADSPI_BK1_IO0
PD0.GPIO_Label=LCD_PSRAM_D2
PD0.Signal=FMC_D2_DA2
PD1.GPIO_Label=LCD_PSRAM_D3
PD1.Signal=FMC_D3_DA3
PD10.GPIO_Label=LCD_PSRAM_D15
PD10.Signal=FMC_D15_DA15
PD11.GPIO_Label=PSRAM_A16
PD11.Signal=FMC_A16_CLE
PD12.GPIO_Label=PSRAM_A17
PD12.Signal=FMC_A17_ALE
PD13.GPIO_Label=QSPI_D3 [MX25L51245G_SIO3]
PD13.Mode=Single Bank 1
PD13.Signal=QUADSPI_BK1_IO3
PD14.GPIO_Label=LCD_PSRAM_D0
PD14.Signal=FMC_D0_DA0
PD15.GPIO_Label=LCD_PSRAM_D1
PD15.Signal=FMC_D1_DA1
PD2.GPIO_Label=UART_RXD_WIFI_TX
PD2.Mode=Asynchronous
PD2.Signal=UART5_RX
PD3.GPIO_Label=WIFI_CH_PD
PD3.Signal=GPIO_Output
PD4.GPIO_Label=LCD_PSRAM_NWE
PD4.Signal=FMC_NOE
PD5.GPIO_Label=LCD_PSRAM_NWE
PD5.Signal=FMC_NWE
PD6.GPIO_Label=WIFI_GPIO_2
PD6.Signal=GPIO_Output
PD7.GPIO_Label=PSRAM_NE1 [IS66WV51216EBLL_CS1]
PD7.Mode=NorPsramChipSelect1_1
PD7.Signal=FMC_NE1
PD8.GPIO_Label=LCD_PSRAM_D13
PD8.Signal=FMC_D13_DA13
PD9.GPIO_Label=LCD_PSRAM_D14
PD9.Signal=FMC_D14_DA14
PE0.GPIO_Label=PSRAM_NBL0 [IS66WV51216EBLL_LB]
PE0.Signal=FMC_NBL0
PE1.GPIO_Label=PSRAM_NBL1 [IS66WV51216EBLL_UB]
PE1.Signal=FMC_NBL1
PE10.GPIO_Label=LCD_PSRAM_D7
PE10.Signal=FMC_D7_DA7
PE11.GPIO_Label=LCD_PSRAM_D8
PE11.Signal=FMC_D8_DA8
PE12.GPIO_Label=LCD_PSRAM_D9
PE12.Signal=FMC_D9_DA9
PE13.GPIO_Label=LCD_PSRAM_D10
PE13.Signal=FMC_D10_DA10
PE14.GPIO_Label=LCD_PSRAM_D11
PE14.Signal=FMC_D11_DA11
PE15.GPIO_Label=LCD_PSRAM_D12
PE15.Signal=FMC_D12_DA12
PE2.GPIO_Label=QSPI_D2 [MX25L51245G_SIO2]
PE2.Mode=Single Bank 1
PE2.Signal=QUADSPI_BK1_IO2
PE3.GPIO_Label=ARD_D7_GPIO
PE3.Signal=GPIO_Output
PE4.GPIO_Label=ARD_D8_GPIO
PE4.Signal=GPIO_Output
PE5.GPIO_Label=ARD_D3_TIM9_CH1
PE5.Signal=S_TIM9_CH1
PE6.GPIO_Label=ARD_D6_TIM9_CH2
PE6.Signal=S_TIM9_CH2
PE7.GPIO_Label=LCD_PSRAM_D4
PE7.Signal=FMC_D4_DA4
PE8.GPIO_Label=LCD_PSRAM_D5
PE8.Signal=FMC_D5_DA5
PE9.GPIO_Label=LCD_PSRAM_D6
PE9.Signal=FMC_D6_DA6
PF0.GPIO_Label=PSRAM_A0
PF0.Signal=FMC_A0
PF1.GPIO_Label=PSRAM_A1
PF1.Signal=FMC_A1
PF10.GPIO_Label=ARD_A3_ADC3_IN8
PF10.Mode=IN8
PF10.Signal=ADC3_IN8
PF11.GPIO_Label=PMOD_RESET
PF11.Signal=GPIO_Input
PF12.GPIO_Label=PSRAM_A6
PF12.Signal=FMC_A6
PF13.GPIO_Label=PSRAM_A7
PF13.Signal=FMC_A7
PF14.GPIO_Label=PSRAM_A8
PF14.Signal=FMC_A8
PF15.GPIO_Label=PSRAM_A9
PF15.Signal=FMC_A9
PF2.GPIO_Label=PSRAM_A2
PF2.Signal=FMC_A2
PF3.GPIO_Label=PSRAM_A3
PF3.Signal=FMC_A3
PF4.GPIO_Label=PSRAM_A4
PF4.Signal=FMC_A4
PF5.GPIO_Label=PSRAM_A5
PF5.Signal=FMC_A5
PF6.GPIO_Label=PMOD_UART7_RXD
PF6.Mode=Asynchronous
PF6.Signal=UART7_RX
PF7.GPIO_Label=PMOD_UART7_TXD
PF7.Mode=Asynchronous
PF7.Signal=UART7_TX
PF8.GPIO_Label=PMOD_UART7_RTS
PF8.Mode=CTS_RTS
PF8.Signal=UART7_RTS
PF9.GPIO_Label=PMOD_UART7_CTS
PF9.Mode=CTS_RTS
PF9.Signal=UART7_CTS
PG0.GPIO_Label=PSRAM_A10
PG0.Signal=FMC_A10
PG1.GPIO_Label=PSRAM_A11
PG1.Signal=FMC_A11
PG10.GPIO_Label=SAI2_SD_B [SAI2_SD_B_ADCDAT1]
PG10.Mode=SAI_B_SyncSlave
PG10.Signal=SAI2_SD_B
PG12.GPIO_Label=PMOD_GPIO_0
PG12.Signal=GPIO_Output
PG13.GPIO_Label=WIFI_GPIO_0
PG13.Signal=GPIO_Output
PG14.GPIO_Label=WIFI_RST
PG14.Signal=GPIO_Output
PG15.GPIO_Label=SAI2_INT [WM8994ECS_GPIO1]
PG15.Signal=GPXTI15
PG2.GPIO_Label=PSRAM_A12
PG2.Signal=FMC_A12
PG3.GPIO_Label=PSRAM_A13
PG3.Signal=FMC_A13
PG4.GPIO_Label=PSRAM_A14
PG4.Signal=FMC_A14_BA0
PG5.GPIO_Label=PSRAM_A15
PG5.Signal=FMC_A15_BA1
PG8.GPIO_Label=USB_OTGFS_PPWR_EN
PG8.Signal=GPIO_Output
PG9.GPIO_Label=LCD_NE
PG9.Mode=NorPsramChipSelect2_2
PG9.Signal=FMC_NE2
PH0-OSC_IN.Mode=HSE-External-Oscillator
PH0-OSC_IN.Signal=RCC_OSC_IN
PH1-OSC_OUT.Mode=HSE-External-Oscillator
PH1-OSC_OUT.Signal=RCC_OSC_OUT
PH10.GPIO_Label=USB_OTGHS_OVCR_INT
PH10.Signal=GPIO_Input
PH11.GPIO_Label=LCD_BL [STLD40DPUR_EN]
PH11.Signal=S_TIM5_CH2
PH12.GPIO_Label=USB_OTGHS_PPWR_EN
PH12.Signal=GPIO_Output
PH13.GPIO_Label=STMOD_UART4_TXD
PH13.Mode=Asynchronous
PH13.Signal=UART4_TX
PH14.GPIO_Label=STMOD_UART4_RXD
PH14.Mode=Asynchronous
PH14.Signal=UART4_RX
PH15.GPIO_Label=PMOD_SEL_0
PH15.PinState=GPIO_PIN_SET
PH15.Signal=GPIO_Output
PH2.GPIO_Label=PMOD_GPIO_1
PH2.Signal=GPIO_Output
PH3.GPIO_Label=ARD_D4_GPIO
PH3.Signal=GPIO_Output
PH4.GPIO_Label=ARD_D15_STMOD_I2C2_SCL
PH4.GPIO_Pu=GPIO_PULLUP
PH4.Mode=I2C
PH4.Signal=I2C2_SCL
PH5.GPIO_Label=ARD_D14_STMOD_I2C2_SDA
PH5.GPIO_Pu=GPIO_PULLUP
PH5.Mode=I2C
PH5.Signal=I2C2_SDA
PH6.GPIO_Label=ARD_D9_TIM12_CH1
PH6.Signal=S_TIM12_CH1
PH7.GPIO_Label=LCD_RST
PH7.Signal=GPIO_Output
PH8.GPIO_Label=CTP_SDA
PH8.GPIO_Pu=GPIO_PULLUP
PH8.Mode=I2C
PH8.Signal=I2C3_SDA
PH9.GPIO_Label=CTP_RST
PH9.Signal=GPIO_Output
PI0.GPIO_Label=PMOD_SPI2_NSS
PI0.Mode=NSS_Signal_Hard_Output
PI0.Signal=SPI2_NSS
PI1.GPIO_Label=PMOD_SPI2_SCK
PI1.Mode=Full_Duplex_Master
PI1.Signal=SPI2_SCK
PI10.Signal=GPIO_Output
PI2.GPIO_Label=PMOD_SPI2_MISO
PI2.Signal=GPIO_Output
PI3.GPIO_Label=PMOD_SPI2_MOSI
PI3.Signal=GPIO_Output
PI4.GPIO_Label=SAI2_MCLK_A [WM8994ECS_MCLK1]
PI4.Mode=SAI_A_MasterWithClock
PI4.Signal=SAI2_MCLK_A
PI5.GPIO_Label=SAI2_SCK_A [WM8994ECS_BCLK1]
PI5.Mode=SAI_A_MasterWithClock
PI5.Signal=SAI2_SCK_A
PI6.GPIO_Label=SAI2_SD_A [WM8994ECS_DACDAT1]
PI6.Mode=SAI_A_MasterWithClock
PI6.Signal=SAI2_SD_A
PI7.GPIO_Label=SAI2_FS_A [WM8994ECS_LRCLK1]
PI7.Mode=SAI_A_MasterWithClock
PI7.Signal=SAI2_FS_A
PI9.GPIO_Label=CTP_INT
PI9.Signal=GPXTI9
ProjectManager.HeapSize=0x200
ProjectManager.StackSize=0x400
ProjectManager.TargetToolchain=STM32CubeIDE
QUADSPI.ChipSelectHighTime=QSPI_CS_HIGH_TIME_4_CYCLE
QUADSPI.ClockPrescaler=1
QUADSPI.FifoThreshold=16
QUADSPI.FlashSize=26
QUADSPI.SampleShifting=QSPI_SAMPLE_SHIFTING_HALFCYCLE
RCC.AHBFreq_Value=216000000
RCC.APB1CLKDivider=RCC_HCLK_DIV4
RCC.APB1Freq_Value=54000000
RCC.APB1TimFreq_Value=108000000
RCC.APB2CLKDivider=RCC_HCLK_DIV2
RCC.APB2Freq_Value=108000000
RCC.APB2TimFreq_Value=216000000
RCC.CortexFreq_Value=216000000
RCC.HCLKFreq_Value=216000000
RCC.HSE_VALUE=25000000
RCC.HSI_VALUE=16000000
RCC.PLLM=25
RCC.PLLN=432
RCC.PLLQ=9
RCC.SYSCLKFreq_VALUE=216000000
RCC.SYSCLKSource=RCC_SYSCLKSOURCE_PLLCLK
RCC.USBFreq_Value=48000000
RCC.VCOOutputFreq_Value=432000000
REXTPHYHS.GPIO_Label=REXT_OTGPHY
REXTPHYHS.Mode=Internal_Phy_Host
REXTPHYHS.Signal=USB_OTG_HS_REXTPHYHS
SAI2.ErrorAudioFreq-SAI_A_MasterWithClock=-2.34 %
SAI2.Instance-SAI_A_MasterWithClock=SAI$Index_Block_A
SAI2.Instance-SAI_B_SyncSlave=SAI$Index_Block_B
SAI2.MClockEnable-SAI_A_MasterWithClock=SAI_MASTERCLOCK_ENABLE
SAI2.RealAudioFreq-SAI_A_MasterWithClock=187.5 KHz
SAI2.VirtualMode-SAI_A_MasterWithClock=VM_MASTER
SAI2.VirtualMode-SAI_B_SyncSlave=VM_SLAVE
SH.ADCx_IN10.0=ADC1_IN10,IN10
SH.ADCx_IN10.1=ADC2_IN10,IN10
SH.ADCx_IN11.0=ADC1_IN11,IN11
SH.ADCx_IN11.1=ADC2_IN11,IN11
SH.ADCx_IN14.0=ADC1_IN14,IN14
SH.ADCx_IN14.1=ADC2_IN14,IN14
SH.ADCx_IN4.0=ADC1_IN4,IN4
SH.ADCx_IN4.1=ADC2_IN4,IN4
SH.ADCx_IN6.0=ADC1_IN6,IN6
SH.ADCx_IN6.1=ADC2_IN6,IN6
SH.FMC_A0.0=FMC_A0,18b-a1
SH.FMC_A0.1=FMC_A0,A0_2
SH.FMC_A1.0=FMC_A1,18b-a1
SH.FMC_A10.0=FMC_A10,18b-a1
SH.FMC_A11.0=FMC_A11,18b-a1
SH.FMC_A12.0=FMC_A12,18b-a1
SH.FMC_A13.0=FMC_A13,18b-a1
SH.FMC_A14_BA0.0=FMC_A14,18b-a1
SH.FMC_A15_BA1.0=FMC_A15,18b-a1
SH.FMC_A16_CLE.0=FMC_A16,18b-a1
SH.FMC_A17_ALE.0=FMC_A17,18b-a1
SH.FMC_A2.0=FMC_A2,18b-a1
SH.FMC_A3.0=FMC_A3,18b-a1
SH.FMC_A4.0=FMC_A4,18b-a1
SH.FMC_A5.0=FMC_A5,18b-a1
SH.FMC_A6.0=FMC_A6,18b-a1
SH.FMC_A7.0=FMC_A7,18b-a1
SH.FMC_A8.0=FMC_A8,18b-a1
SH.FMC_A9.0=FMC_A9,18b-a1
SH.FMC_D0_DA0.0=FMC_D0,16b-d1
SH.FMC_D0_DA0.1=FMC_D0,16b-d2
SH.FMC_D10_DA10.0=FMC_D10,16b-d1
SH.FMC_D10_DA10.1=FMC_D10,16b-d2
SH.FMC_D11_DA11.0=FMC_D11,16b-d1
SH.FMC_D11_DA11.1=FMC_D11,16b-d2
SH.FMC_D12_DA12.0=FMC_D12,16b-d1
SH.FMC_D12_DA12.1=FMC_D12,16b-d2
SH.FMC_D13_DA13.0=FMC_D13,16b-d1
SH.FMC_D13_DA13.1=FMC_D13,16b-d2
SH.FMC_D14_DA14.0=FMC_D14,16b-d1
SH.FMC_D14_DA14.1=FMC_D14,16b-d2
SH.FMC_D15_DA15.0=FMC_D15,16b-d1
SH.FMC_D15_DA15.1=FMC_D15,16b-d2
SH.FMC_D1_DA1.0=FMC_D1,16b-d1
SH.FMC_D1_DA1.1=FMC_D1,16b-d2
SH.FMC_D2_DA2.0=FMC_D2,16b-d1
SH.FMC_D2_DA2.1=FMC_D2,16b-d2
SH.FMC_D3_DA3.0=FMC_D3,16b-d1
SH.FMC_D3_DA3.1=FMC_D3,16b-d2
SH.FMC_D4_DA4.0=FMC_D4,16b-d1
SH.FMC_D4_DA4.1=FMC_D4,16b-d2
SH.FMC_D5_DA5.0=FMC_D5,16b-d1
SH.FMC_D5_DA5.1=FMC_D5,16b-d2
SH.FMC_D6_DA6.0=FMC_D6,16b-d1
SH.FMC_D6_DA6.1=FMC_D6,16b-d2
SH.FMC_D7_DA7.0=FMC_D7,16b-d1
SH.FMC_D7_DA7.1=FMC_D7,16b-d2
SH.FMC_D8_DA8.0=FMC_D8,16b-d1
SH.FMC_D8_DA8.1=FMC_D8,16b-d2
SH.FMC_D9_DA9.0=FMC_D9,16b-d1
SH.FMC_D9_DA9.1=FMC_D9,16b-d2
SH.FMC_NBL0.0=FMC_NBL0,2ByteEnable1
SH.FMC_NBL1.0=FMC_NBL1,2ByteEnable1
SH.FMC_NL.0=FMC_NL,AddressValid1
SH.FMC_NOE.0=FMC_NOE,Psram1
SH.FMC_NOE.1=FMC_NOE,Lcd2
SH.FMC_NWE.0=FMC_NWE,Psram1
SH.FMC_NWE.1=FMC_NWE,Lcd2
SH.S_TIM12_CH1.0=TIM12_CH1,PWM Generation1 CH1
SH.S_TIM2_CH2.0=TIM2_CH2,PWM Generation2 CH2
SH.S_TIM3_CH3.0=TIM3_CH3,PWM Generation3 CH3
SH.S_TIM5_CH2.0=TIM5_CH2,PWM Generation2 CH2
SH.S_TIM9_CH1.0=TIM9_CH1,PWM Generation1 CH1
SH.S_TIM9_CH2.0=TIM9_CH2,PWM Generation2 CH2
SPI1.BaudRatePrescaler=SPI_BAUDRATEPRESCALER_4
SPI1.CalculateBaudRate=27.0 MBits/s
SPI1.Direction=SPI_DIRECTION_2LINES
SPI1.Mode=SPI_MODE_MASTER
SPI1.VirtualType=VM_MASTER
SPI2.BaudRatePrescaler=SPI_BAUDRATEPRESCALER_4
SPI2.CalculateBaudRate=13.5 MBits/s
SPI2.Direction=SPI_DIRECTION_2LINES
SPI2.Mode=SPI_MODE_MASTER
SPI2.VirtualNSS=VM_NSSHARD
SPI2.VirtualType=VM_MASTER
TIM12.Channel-PWM\ Generation1\ CH1=TIM_CHANNEL_1
TIM2.Channel-PWM\ Generation2\ CH2=TIM_CHANNEL_2
TIM2.Period=10000-1
TIM2.Prescaler=10800-1
TIM3.Channel-PWM\ Generation3\ CH3=TIM_CHANNEL_3
TIM5.Channel-PWM\ Generation2\ CH2=TIM_CHANNEL_2
TIM9.Channel-PWM\ Generation1\ CH1=TIM_CHANNEL_1
TIM9.Channel-PWM\ Generation2\ CH2=TIM_CHANNEL_2
USART2.VirtualMode-Asynchronous=VM_ASYNC
USART6.VirtualMode-Asynchronous=VM_ASYNC
USB_HOST.BSP.number=2
USB_HOST.USBH_HandleTypeDef-AUDIO_HS=hUsbHostHS
USB_HOST.USBH_HandleTypeDef-MSC_FS=hUsbHostFS
USB_HOST.VirtualModeFS=Msc
USB_HOST.VirtualModeHS=Audio
USB_HOST0.BSP.STBoard=false
USB_HOST0.BSP.api=Unknown
USB_HOST0.BSP.instance=PG8
USB_HOST0.BSP.ip=GPIO
USB_HOST0.BSP.mode=Output
USB_HOST0.BSP.name=Drive_VBUS_FS
USB_HOST0.BSP.solution=PG8
USB_HOST1.BSP.STBoard=false
USB_HOST1.BSP.api=Unknown
USB_HOST1.BSP.instance=PH12
USB_HOST1.BSP.ip=GPIO
USB_HOST1.BSP.mode=Output
USB_HOST1.BSP.name=Drive_VBUS_HS
USB_HOST1.BSP.solution=PH12
USB_OTG_FS.VirtualMode=Host_Only
USB_OTG_FS.phy_itface=HCD_PHY_EMBEDDED
USB_OTG_HS.VirtualMode=Int_Phy_Host
VP_SYS_VS_tim1.Mode=TIM1
VP_TIM2_VS_ClockSourceINT.Mode=Internal
VP_USB_HOST_VS_USB_HOST_AUDIO_HS.Mode=AUDIO_HS
VP_USB_HOST_VS_USB_HOST_MSC_FS.Mode=MSC_FS
board=STM32F723E-DISCO

// file: Core/Src/main.c
/* USER CODE BEGIN Header */
/**
  ******************************************************************************
  * @file           : main.c
  * @brief          : Main program body
  ******************************************************************************
  * @attention
  *
  * Copyright (c) 2026 STMicroelectronics.
  * All rights reserved.
  *
  * This software is licensed under terms that can be found in the LICENSE file
  * in the root directory of this software component.
  * If no LICENSE file comes with this software, it is provided AS-IS.
  *
  ******************************************************************************
  */
/* USER CODE END Header */
#include "main.h"
#include "adc.h"
#include "i2c.h"
#include "quadspi.h"
#include "sai.h"
#include "spi.h"
#include "tim.h"
#include "usart.h"
#include "usb_host.h"
#include "gpio.h"
#include "fmc.h"

/* USER CODE BEGIN Includes */
#include <stdio.h>
#include <string.h>
/* USER CODE END Includes */

void SystemClock_Config(void);
void PeriphCommonClock_Config(void);
void MX_USB_HOST_Process(void);

/* USER CODE BEGIN 0 */
	char data[10] = "happycat";
	int upEdge = 0;
	int downEdge = 0;
	void HAL_TIM_IRQHandler(TIM_HandleTypeDef *htim)
/* USER CODE END 0 */

int main(void)
{

  /* MCU Configuration--------------------------------------------------------*/

  /* Reset of all peripherals, Initializes the Flash interface and the Systick. */
  HAL_Init();

  /* Configure the system clock */
  SystemClock_Config();

  /* Configure the peripherals common clocks */
  PeriphCommonClock_Config();

  /* Initialize all configured peripherals */
  MX_GPIO_Init();
  MX_ADC1_Init();
  MX_ADC2_Init();
  MX_ADC3_Init();
  MX_FMC_Init();
  MX_I2C1_Init();
  MX_I2C2_Init();
  MX_I2C3_Init();
  MX_QUADSPI_Init();
  MX_SAI2_Init();
  MX_SPI1_Init();
  MX_SPI2_Init();
  MX_TIM2_Init();
  MX_TIM3_Init();
  MX_TIM5_Init();
  MX_TIM9_Init();
  MX_TIM12_Init();
  MX_UART4_Init();
  MX_UART5_Init();
  MX_UART7_Init();
  MX_USART2_UART_Init();
  MX_USART6_UART_Init();
  MX_USB_HOST_Init();
  /* USER CODE BEGIN 2 */
  HAL_TIM_Base_Start_IT(&htim2);
  int counter = 0;
  char message[20];
  /* USER CODE END 2 */

  /* Infinite loop */
  while (1)
  {
    MX_USB_HOST_Process();

    /* USER CODE BEGIN 3 */
	  counter = __HAL_TIM_GET_COUNTER(&htim2);
	  sprintf(message,"counter:%d", counter);
//	  HAL_UART_Transmit_IT(&huart2, (uint8_t *)message, strlen(message));
	  HAL_Delay(99);

//    HAL_UART_Transmit(&huart2, (uint8_t *)"HELLO", 6, 0XFFFFF);

    }

  /* USER CODE END 3 */
}

void SystemClock_Config(void)
{
  RCC_OscInitTypeDef RCC_OscInitStruct = {0};
  RCC_ClkInitTypeDef RCC_ClkInitStruct = {0};

  /** Configure LSE Drive Capability
  */
  HAL_PWR_EnableBkUpAccess();

  /** Configure the main internal regulator output voltage
  */
  __HAL_RCC_PWR_CLK_ENABLE();
  __HAL_PWR_VOLTAGESCALING_CONFIG(PWR_REGULATOR_VOLTAGE_SCALE1);

  /** Initializes the RCC Oscillators according to the specified parameters
  * in the RCC_OscInitTypeDef structure.
  */
  RCC_OscInitStruct.OscillatorType = RCC_OSCILLATORTYPE_HSE;
  RCC_OscInitStruct.HSEState = RCC_HSE_ON;
  RCC_OscInitStruct.PLL.PLLState = RCC_PLL_ON;
  RCC_OscInitStruct.PLL.PLLSource = RCC_PLLSOURCE_HSE;
  RCC_OscInitStruct.PLL.PLLM = 25;
  RCC_OscInitStruct.PLL.PLLN = 432;
  RCC_OscInitStruct.PLL.PLLP = RCC_PLLP_DIV2;
  RCC_OscInitStruct.PLL.PLLQ = 9;
  if (HAL_RCC_OscConfig(&RCC_OscInitStruct) != HAL_OK)
  {
    Error_Handler();
  }

  /** Activate the Over-Drive mode
  */
  if (HAL_PWREx_EnableOverDrive() != HAL_OK)
  {
    Error_Handler();
  }

  /** Initializes the CPU, AHB and APB buses clocks
  */
  RCC_ClkInitStruct.ClockType = RCC_CLOCKTYPE_HCLK|RCC_CLOCKTYPE_SYSCLK
                              |RCC_CLOCKTYPE_PCLK1|RCC_CLOCKTYPE_PCLK2;
  RCC_ClkInitStruct.SYSCLKSource = RCC_SYSCLKSOURCE_PLLCLK;
  RCC_ClkInitStruct.AHBCLKDivider = RCC_SYSCLK_DIV1;
  RCC_ClkInitStruct.APB1CLKDivider = RCC_HCLK_DIV4;
  RCC_ClkInitStruct.APB2CLKDivider = RCC_HCLK_DIV2;

  if (HAL_RCC_ClockConfig(&RCC_ClkInitStruct, FLASH_LATENCY_7) != HAL_OK)
  {
    Error_Handler();
  }
}

void PeriphCommonClock_Config(void)
{
  RCC_PeriphCLKInitTypeDef PeriphClkInitStruct = {0};

  /** Initializes the peripherals clock
  */
  PeriphClkInitStruct.PeriphClockSelection = RCC_PERIPHCLK_SAI2|RCC_PERIPHCLK_CLK48;
  PeriphClkInitStruct.PLLSAI.PLLSAIN = 192;
  PeriphClkInitStruct.PLLSAI.PLLSAIQ = 2;
  PeriphClkInitStruct.PLLSAI.PLLSAIP = RCC_PLLSAIP_DIV2;
  PeriphClkInitStruct.PLLSAIDivQ = 1;
  PeriphClkInitStruct.Sai2ClockSelection = RCC_SAI2CLKSOURCE_PLLSAI;
  if (HAL_RCCEx_PeriphCLKConfig(&PeriphClkInitStruct) != HAL_OK)
  {
    Error_Handler();
  }
}

void HAL_TIM_PeriodElapsedCallback(TIM_HandleTypeDef *htim)
{
  /* USER CODE BEGIN Callback 0 */
	if (htim == &htim2){
		HAL_UART_Transmit_IT(&huart2, (uint8_t*) data, strlen (data));
	}
  /* USER CODE END Callback 0 */
  if (htim->Instance == TIM1)
  {
    HAL_IncTick();
  }
}

void Error_Handler(void)
{
  __disable_irq();
  while (1)
  {
  }
}
